## scale/sdkconfig.defaults
```kconfig
# ============================================================
# 体重秤 —— sdkconfig.defaults
#
# 目标芯片：见 docs/HARDWARE.md。
#   默认按 **ESP32（经典款）** 配。若用手头的 ESP32-S3 板子，
#   执行 `idf.py set-target esp32s3` 即可（本文件里的条目两边都适用）。
# ESP-IDF v5.5.5
# ============================================================

# ---- 分区表 ----
CONFIG_PARTITION_TABLE_CUSTOM=y
CONFIG_PARTITION_TABLE_CUSTOM_FILENAME="partitions.csv"

# ---- Flash ----
CONFIG_ESPTOOLPY_FLASHSIZE_4MB=y
CONFIG_ESPTOOLPY_FLASHFREQ_80M=y

# ---- FreeRTOS ----
CONFIG_FREERTOS_HZ=1000

# ---- WiFi ----
CONFIG_ESP_WIFI_STA_DISCONNECTED_PM_ENABLE=n

# ---- 日志 ----
CONFIG_LOG_DEFAULT_LEVEL_INFO=y
CONFIG_LOG_COLORS=y

# ---- 优化 ----
CONFIG_COMPILER_OPTIMIZATION_SIZE=y

# ---- 串口：监视 115200 ----
CONFIG_MONITOR_BAUD=115200

# ---- 任务看门狗：调试期先关（标定命令里有较长阻塞）----
CONFIG_ESP_TASK_WDT_INIT=n
```
